#include "Easy_Menu_User.h"

/* Easy Menu User Configuration File */
/* This file is auto-generated by Easy Menu Builder */
/* Configuration: User_Menu_Config */

/* USER CODE PUBLIC BEGIN */
#include "LED.h"
#include "encoder.h"
#include "motor.h"
#include "pid.h"
#include "task.h"
extern float ypr[3];
extern float yaw_angle;
extern char gray_digital_str[5];        // 4路数字灰度传感器 + '\0'
// 旧的8路模拟灰度传感器变量已注释
// extern unsigned short gray_analog[8];   // 原始模拟量数据
// extern uint16_t gray_white_ref[8];      // 白色参考值
// extern uint16_t gray_black_ref[8];      // 黑色参考值
// extern uint16_t gray_threshold[8];      // 灰度阈值
extern volatile int16_t speedA, speedB; // 编码器速度
extern uint8_t ls_lap_target;           // 循迹圈数目标
// 旧的校准函数已注释
// extern void Gray_White_Cal_Start(void);
// extern void Gray_Black_Cal_Start(void);
void Gray_Digital_Format(void *data, char *buf, int buf_size); // 灰度数字值
void Timer_Format(void *data, char *buf, int buf_size);        // 任务计时格式化

/* USER CODE PUBLIC END */

/* ================================================================= 占位变量 ================================================================= */
struct {
    unsigned char LED1__data;
    unsigned char LED2__data;
    unsigned char LED3__data;
    unsigned char LED4__data;
    unsigned char uint8_data;
    unsigned short int uint16_data;
    unsigned int uint32_data;
    signed char int8_data;
    signed short int int16_data;
    signed int int32_data;
    float float_data;
    unsigned char hours;
    unsigned char minutes;
    unsigned char seconds;
    unsigned char millisecond;
    float yaw;
    float roll;
    float pitch;
    unsigned char gray_digital_data;
    unsigned short int CH1_data;
    unsigned short int CH2_data;
    unsigned short int CH3_data;
    unsigned short int CH4_data;
    unsigned short int CH5_data;
    unsigned short int CH6_data;
    unsigned short int CH7_data;
    unsigned short int CH8_data;
    unsigned char gray_white_cal;
    unsigned char gray_black_cal;
    unsigned char gray__12__item__data;
    float speedA;
    float speedB;
    unsigned char tim_s;    // 用于计时显示
    unsigned char timer;    // 计时格式化显示
    unsigned char task1_flag;
    unsigned char task2_flag;
    unsigned char task3_flag;
    unsigned char task4_flag;
    unsigned char task5_flag;
    unsigned int dist__data;
} Easy_Menu_Ui_Data = {
    .LED1__data = 0,
    .LED2__data = 0,
    .LED3__data = 0,
    .LED4__data = 0,
    .uint8_data = 1,
    .uint16_data = 2,
    .uint32_data = 3,
    .int8_data = 4,
    .int16_data = 5,
    .int32_data = 6,
    .float_data = 7.0f,
    .hours = 23,
    .minutes = 59,
    .seconds = 55,
    .millisecond = 0,
    .yaw = 0.0f,
    .roll = 0.0f,
    .pitch = 0.0f,
    .gray_digital_data = 0,
    .CH1_data = 0,
    .CH2_data = 0,
    .CH3_data = 0,
    .CH4_data = 0,
    .CH5_data = 0,
    .CH6_data = 0,
    .CH7_data = 0,
    .CH8_data = 0,
    .gray_white_cal = 0,
    .gray_black_cal = 0,
    .gray__12__item__data = 0,
    .speedA = 0.0f,
    .speedB = 0.0f,
    .tim_s = 0,
    .timer = 0,
    .task1_flag = 0,
    .task2_flag = 0,
    .task3_flag = 0,
    .task4_flag = 0,
    .task5_flag = 0,
    .dist__data = 5980,
};
/* ============================================================== 页面、条目定义 ============================================================== */    
Ordinary_Page main_page;
    Goto_Item goto__start_page;
    Goto_Item goto__Text_Page;
    Goto_Item goto__Switch_Page;
    Goto_Item goto__Data_Page;
    Goto_Item goto__Enum_Page;
    Goto_Item goto__User_Show_Page;
    Goto_Item goto__Goto_Page;
    Goto_Item goto__Data_Show;
    Goto_Item goto__Gray;
    Goto_Item goto__encoder;
    Goto_Item goto__TASK;
    Show_Page start_page;
    Ordinary_Page Text_Page;
        Text_Item text_page__1__item;
        Text_Item text_page__2__item;
        Text_Item text_page__3__item;
        Text_Item text_page__4__item;
    Ordinary_Page Switch_Page;
        Switch_Item switch_page__1__item;
        Switch_Item switch_page__2__item;
        Switch_Item switch_page__3__item;
        Switch_Item switch_page__4__item;
    Ordinary_Page Data_Page;
        Data_Item data_page__1__item;
        Data_Item data_page__2__item;
        Data_Item data_page__3__item;
        Data_Item data_page__4__item;
        Data_Item data_page__5__item;
        Data_Item data_page__6__item;
        Data_Item data_page__7__item;
    Ordinary_Page Enum_Page;
        Enum_Item mode;
        Enum_Item state;
    Ordinary_Page User_Show_Page;
        Show_Item user_show_page__1__item;
        Show_Item user_show_page__2__item;
        Show_Item user_show_page__3__item;
        Show_Item user_show_page__4__item;
    Ordinary_Page Goto_Page;
        Goto_Item goto__goto_1_page;
        Goto_Item goto__Goto_Page_2;
        Goto_Item goto__goto_3_page;
        Goto_Item goto__Goto_Page_4;
        Ordinary_Page goto_1_page;
            Goto_Item goto__goto_11_page;
            Ordinary_Page goto_11_page;
                Goto_Item goto__goto_111_page;
                Ordinary_Page goto_111_page;
                    Text_Item goto_111_page__1__item;
                    Goto_Item goto__goto_111_page__2__item;
        Ordinary_Page goto_3_page;
            Text_Item test;
    Ordinary_Page Data_Show;
        Show_Item Data_Show__yaw;
        Show_Item Data_Show__roll;
        Show_Item Data_Show__pitch;
    Ordinary_Page Gray;
        Show_Item gray_digital;
        Show_Item CH1;
        Show_Item CH2;
        Show_Item CH3;
        Show_Item CH4;
        Show_Item CH5;
        Show_Item CH6;
        Show_Item CH7;
        Show_Item CH8;
        Switch_Item gray_white_cal;
        Switch_Item gray_black_cal;
        Show_Item gray__12__item;
    Ordinary_Page encoder;
        Show_Item show_speedA;
        Show_Item show_speedB;
    Ordinary_Page TASK;
        Show_Item timer;
        Switch_Item task__1__item;
        Switch_Item task__3__item;
        Switch_Item task__4__item;
        Switch_Item task__5__item;
        Switch_Item task__6__item;
        Data_Item task__8__item;
/* ================================================================= 枚举列表 ================================================================= */
char *mode_enum_str[3] = {
    "Static",
    "Slow",
    "Fast"
};

char *state_enum_str[2] = {
    "Run",
    "Stop"
};

/* ============================================================== 回调函数（条目） ============================================================ */
void Text_Page__2__Item_Callback(char *str)
{
    /* USER CODE BEGIN */

    /* USER CODE END */
}

void Switch_Page__1__Item_Callback(unsigned char data)
{
    /* USER CODE BEGIN */
    if (Easy_Menu_Ui_Data.LED1__data == 1)
    {
        Easy_Menu_Ui_Data.LED1__data = 0;
        LED_On();
    }
    else
    {
        Easy_Menu_Ui_Data.LED1__data = 1;
        LED_Off();
    }
    /* USER CODE END */
}

void Switch_Page__2__Item_Callback(unsigned char data)
{
    /* USER CODE BEGIN */

    /* USER CODE END */
}

void Switch_Page__3__Item_Callback(unsigned char data)
{
    /* USER CODE BEGIN */

    /* USER CODE END */
}

void Switch_Page__4__Item_Callback(unsigned char data)
{
    /* USER CODE BEGIN */

    /* USER CODE END */
}

void Data_Page__1__Item_Callback(void *data) // *((unsigned char*)data)
{
    /* USER CODE BEGIN */

    /* USER CODE END */
}

void Data_Page__2__Item_Callback(void *data) // *((unsigned short int*)data)
{
    /* USER CODE BEGIN */

    /* USER CODE END */
}

void Data_Page__3__Item_Callback(void *data) // *((unsigned int*)data)
{
    /* USER CODE BEGIN */

    /* USER CODE END */
}

void Data_Page__4__Item_Callback(void *data) // *((signed char*)data)
{
    /* USER CODE BEGIN */

    /* USER CODE END */
}

void Data_Page__5__Item_Callback(void *data) // *((signed short int*)data)
{
    /* USER CODE BEGIN */
    printf("Data_Page__5__Item_Callback:%d\n", *((signed short int *)data));
    /* USER CODE END */
}

void Data_Page__6__Item_Callback(void *data) // *((signed int*)data)
{
    /* USER CODE BEGIN */

    /* USER CODE END */
}

void Data_Page__7__Item_Callback(void *data) // *((float*)data)
{
    /* USER CODE BEGIN */

    /* USER CODE END */
}

void Mode_Callback(char *str)
{
    /* USER CODE BEGIN */

    /* USER CODE END */
}

void User_Show_Page__1__Item_Callback(void)
{
    /* USER CODE BEGIN */
    if (Easy_Menu_Ui_Data.hours >= 24)
    {
        Easy_Menu_Ui_Data.hours = 0;
    }
    /* USER CODE END */
}

void User_Show_Page__2__Item_Callback(void)
{
    /* USER CODE BEGIN */
    if (Easy_Menu_Ui_Data.minutes >= 60)
    {
        Easy_Menu_Ui_Data.minutes = 0;
        Easy_Menu_Ui_Data.hours++;
    }
    /* USER CODE END */
}

void User_Show_Page__3__Item_Callback(void)
{
    /* USER CODE BEGIN */
    if (Easy_Menu_Ui_Data.seconds >= 60)
    {
        Easy_Menu_Ui_Data.seconds = 0;
        Easy_Menu_Ui_Data.minutes++;
    }
    /* USER CODE END */
}

void User_Show_Page__4__Item_Callback(void)
{
    /* USER CODE BEGIN */
    static unsigned int Show_Page_4_Item_Last_Tick = 0;

    Easy_Menu_Ui_Data.millisecond += (easy_menu.tick - Show_Page_4_Item_Last_Tick) / 10;

    Show_Page_4_Item_Last_Tick = easy_menu.tick;

    if (Easy_Menu_Ui_Data.millisecond >= 100)
    {
        Easy_Menu_Ui_Data.millisecond = 0;
        Easy_Menu_Ui_Data.seconds++;
    }
    /* USER CODE END */
}

void Data_Show__Yaw_Callback(void)
{
    /* USER CODE BEGIN */
    Easy_Menu_Ui_Data.yaw = yaw_angle;
    /* USER CODE END */
}

void Data_Show__Roll_Callback(void)
{
    /* USER CODE BEGIN */
    Easy_Menu_Ui_Data.roll = ypr[1];
    /* USER CODE END */
}

void Data_Show__Pitch_Callback(void)
{
    /* USER CODE BEGIN */
    Easy_Menu_Ui_Data.pitch = ypr[2];
    /* USER CODE END */
}

void Gray_Digital_Callback(void)
{
    /* USER CODE BEGIN */
    extern char gray_digital_str[5];  // 4路数字灰度传感器 + '\0'
    extern uint8_t gray_digital_value;

    // 更新4路数字传感器值
    gray_digital_value = 0;
    if (gray_digital_str[0] == '1') gray_digital_value |= (1 << 0);  // PA15
    if (gray_digital_str[1] == '1') gray_digital_value |= (1 << 1);  // PA16
    if (gray_digital_str[2] == '1') gray_digital_value |= (1 << 2);  // PA17
    if (gray_digital_str[3] == '1') gray_digital_value |= (1 << 3);  // PA27

    // 更新UI数据
    Easy_Menu_Ui_Data.gray_digital_data = gray_digital_value;
    Easy_Menu_Ui_Data.CH1_data = (gray_digital_str[0] == '1') ? 1 : 0;  // PA15
    Easy_Menu_Ui_Data.CH2_data = (gray_digital_str[1] == '1') ? 1 : 0;  // PA16
    Easy_Menu_Ui_Data.CH3_data = (gray_digital_str[2] == '1') ? 1 : 0;  // PA17
    Easy_Menu_Ui_Data.CH4_data = (gray_digital_str[3] == '1') ? 1 : 0;  // PA27
    /* USER CODE END */
}

void Ch1_Callback(void)
{
    /* USER CODE BEGIN */
//     Easy_Menu_Ui_Data.CH1_data = gray_analog[0];
    /* USER CODE END */
}

void Ch2_Callback(void)
{
    /* USER CODE BEGIN */
//     Easy_Menu_Ui_Data.CH2_data = gray_analog[1];
    /* USER CODE END */
}

void Ch3_Callback(void)
{
    /* USER CODE BEGIN */
//     Easy_Menu_Ui_Data.CH3_data = gray_analog[2];
    /* USER CODE END */
}

void Ch4_Callback(void)
{
    /* USER CODE BEGIN */
//     Easy_Menu_Ui_Data.CH4_data = gray_analog[3];
    /* USER CODE END */
}

void Ch5_Callback(void)
{
    /* USER CODE BEGIN */
//     Easy_Menu_Ui_Data.CH5_data = gray_analog[4];
    /* USER CODE END */
}

void Ch6_Callback(void)
{
    /* USER CODE BEGIN */
//     Easy_Menu_Ui_Data.CH6_data = gray_analog[5];
    /* USER CODE END */
}

void Ch7_Callback(void)
{
    /* USER CODE BEGIN */
//     Easy_Menu_Ui_Data.CH7_data = gray_analog[6];
    /* USER CODE END */
}

void Ch8_Callback(void)
{
    /* USER CODE BEGIN */
//     Easy_Menu_Ui_Data.CH8_data = gray_analog[7];
    /* USER CODE END */
}

void Gray_White_Cal_Callback(unsigned char data)
{
    /* USER CODE BEGIN */
//     if (data == 1)
//         Gray_White_Cal_Start();
    /* USER CODE END */
}

void Gray_Black_Cal_Callback(unsigned char data)
{
    /* USER CODE BEGIN */
//     if (data == 1)
//         Gray_Black_Cal_Start();
    /* USER CODE END */
}

void Gray__12__Item_Callback(void)
{
    /* USER CODE BEGIN */

    /* USER CODE END */
}

void Show_Speeda_Callback(void)
{
    /* USER CODE BEGIN */
    static int cnt = 0;
    if (++cnt >= 10)
    {
        cnt = 0;
        Easy_Menu_Ui_Data.speedA = speedA;
    }
    /* USER CODE END */
}

void Show_Speedb_Callback(void)
{
    /* USER CODE BEGIN */
    static int cnt = 0;
    if (++cnt >= 10)
    {
        cnt = 0;
        Easy_Menu_Ui_Data.speedB = speedB;
    }
    /* USER CODE END */
}

/* 秒表共享状态 */
static volatile uint8_t  stopwatch_running = 0;
static volatile uint32_t stopwatch_total_ms = 0;
static volatile unsigned int stopwatch_last_tick = 0;

static void Stopwatch_Update(void)
{
    if (!stopwatch_running || !task_timer_running) return;
    unsigned int now = easy_menu.tick;
    unsigned int delta = now - stopwatch_last_tick;
    stopwatch_last_tick = now;
    stopwatch_total_ms += delta;
}

void Stopwatch_Stop(void)
{
    stopwatch_running = 0;
}

void Timer_Format(void *data, char *buf, int buf_size)
{
    (void)data;
    uint32_t sec = (stopwatch_total_ms / 1000) % 100;
    uint32_t tenth = (stopwatch_total_ms / 100) % 10;
    snprintf(buf, buf_size, "%02u.%u", sec, tenth);
}

void Timer_Callback(void)
{
    /* USER CODE BEGIN */
    Stopwatch_Update();
    if (timer.format == NULL)
        timer.format = Timer_Format;
    Easy_Menu_Ui_Data.timer = (stopwatch_total_ms / 100) % 100;
    /* USER CODE END */
}

void Task__1__Item_Callback(unsigned char data)
{
    /* USER CODE BEGIN */
    extern volatile uint8_t task1_flag;
    extern TaskMode_t task_mode;
    if (data == 1)
    {
        task1_flag = 1; 
        stopwatch_total_ms = 0;
        stopwatch_last_tick = easy_menu.tick;
        stopwatch_running = 1;
    }
    else
    {
        task_mode = TASK_IDLE;
        Set_PWM(0, 0);
        stopwatch_running = 0;
    }
    /* USER CODE END */
}

void Task__3__Item_Callback(unsigned char data)
{
    /* USER CODE BEGIN */
    extern volatile uint8_t task2_flag;
    extern TaskMode_t task_mode;
    if (data == 1)
    {
        task2_flag = 1;
        stopwatch_total_ms = 0;
        stopwatch_last_tick = easy_menu.tick;
        stopwatch_running = 1;
    }
    else
    {
        task_mode = TASK_IDLE;
        Set_PWM(0, 0);
        stopwatch_running = 0;
    }
    /* USER CODE END */
}

void Task__4__Item_Callback(unsigned char data)
{
    /* USER CODE BEGIN */
    extern volatile uint8_t task3_flag;
    extern TaskMode_t task_mode;
    if (data == 1)
    {
        task3_flag = 1;
        stopwatch_total_ms = 0;
        stopwatch_last_tick = easy_menu.tick;
        stopwatch_running = 1;
    }
    else
    {
        task_mode = TASK_IDLE;
        Set_PWM(0, 0);
        stopwatch_running = 0;
    }
    /* USER CODE END */
}

void Task__5__Item_Callback(unsigned char data)
{
    /* USER CODE BEGIN */
    extern volatile uint8_t task4_flag;
    extern TaskMode_t task_mode;
    if (data == 1)
    {
        task4_flag = 1;
        stopwatch_total_ms = 0;
        stopwatch_last_tick = easy_menu.tick;
        stopwatch_running = 1;
    }
    else
    {
        task_mode = TASK_IDLE;
        Set_PWM(0, 0);
        stopwatch_running = 0;
    }
    /* USER CODE END */
}

void Task__6__Item_Callback(unsigned char data)
{
    /* USER CODE BEGIN */
    extern volatile uint8_t task5_flag;
    extern TaskMode_t task_mode;
    if (data == 1)
    {
        task5_flag = 1;
        stopwatch_total_ms = 0;
        stopwatch_last_tick = easy_menu.tick;
        stopwatch_running = 1;
    }
    else
    {
        task_mode = TASK_IDLE;
        Set_PWM(0, 0);
        stopwatch_running = 0;
    }
    /* USER CODE END */
}

void Task__8__Item_Callback(void *data) // *((unsigned int*)data)
{
    /* USER CODE BEGIN */
    ls_lap_target = *((unsigned char *)data);
    /* USER CODE END */
}

/* ============================================================== 回调函数（页面） ============================================================ */
/* Private variables ---------------------------------------------------------*/
/* USER CODE VALUE BEGIN */
/* 同步外部PID变量到菜单内部变量（启动时调用一次） */
// void Easy_Menu_Sync_PID(void)
// {
//     Easy_Menu_Ui_Data.Kp = Kp;
//     Easy_Menu_Ui_Data.Ki = Ki;
//     Easy_Menu_Ui_Data.Kd = Kd;
// }

const char ch[4] = {'|', '/', '-', '\\'};
unsigned char show_page_len = 0;
unsigned char show_page_index = 0;
unsigned char ch_index = 0;

/* 灰度 digital 二进制格式化：直接拷贝 empty.c 生成的二进制字符串 */
void Gray_Digital_Format(void *data, char *buf, int buf_size)
{
    (void)data;
    strncpy(buf, gray_digital_str, buf_size - 1);
    buf[buf_size - 1] = '\0';
}

/* USER CODE VALUE END */
/* Private function ----------------------------------------------------------*/
void Start_Page_Enter_Callback(void)
{
    /* USER CODE BEGIN */
    char title[] = "Easy Menu";

    if (easy_menu.Display_Char != NULL)
    {
        for (unsigned char i = 0; i < strlen(title); i++)
            easy_menu.Display_Char((SCREEN_WIDTH / 2) - (strlen(title) * CHAR_WIDTH / 2) + i * CHAR_WIDTH, 0, title[i], 0);

        easy_menu.Display_Char(CHAR_WIDTH, (SCREEN_HEIGHT / 2) - (CHAR_HEIGHT / 2), '[', 0);

        easy_menu.Display_Char(SCREEN_WIDTH - CHAR_WIDTH, (SCREEN_HEIGHT / 2) - (CHAR_HEIGHT / 2), ']', 0);

        show_page_len = (SCREEN_WIDTH - CHAR_WIDTH * 3) / CHAR_WIDTH;

        for (unsigned char i = 0; i < show_page_len; i++)
            easy_menu.Display_Char(CHAR_WIDTH * 2 + i * CHAR_WIDTH, (SCREEN_HEIGHT / 2) - (CHAR_HEIGHT / 2), '-', 0);
    }
    else if (easy_menu.Display_Char_Line != NULL)
    {
        for (unsigned char i = 0; i < strlen(title); i++)
            easy_menu.Display_Char_Line((SCREEN_WIDTH / 2) - (strlen(title) * CHAR_WIDTH / 2) + i * CHAR_WIDTH, 0, title[i], 0);

        easy_menu.Display_Char_Line(CHAR_WIDTH, EASY_MENU_LINE_MAX_NUM / 2, '[', 0);

        easy_menu.Display_Char_Line(SCREEN_WIDTH - CHAR_WIDTH, EASY_MENU_LINE_MAX_NUM / 2, ']', 0);

        show_page_len = (SCREEN_WIDTH - CHAR_WIDTH * 3) / CHAR_WIDTH;

        for (unsigned char i = 0; i < show_page_len; i++)
            easy_menu.Display_Char_Line(CHAR_WIDTH * 2 + i * CHAR_WIDTH, EASY_MENU_LINE_MAX_NUM / 2, '-', 0);
    }

    show_page_index = 0;
    ch_index = 0;
    /* USER CODE END */
}

void Start_Page_Period_Callback(void* temp, Easy_Menu_Input_TYPE user_input)
{
    /* USER CODE BEGIN */
    if (easy_menu.Display_Char != NULL)
    {
        easy_menu.Display_Char(0, (SCREEN_HEIGHT / 2) - (CHAR_HEIGHT / 2), ch[ch_index], 0);

        for (unsigned char i = 0; i < show_page_index; i++)
        {
            easy_menu.Display_Char(CHAR_WIDTH * 2 + i * CHAR_WIDTH, (SCREEN_HEIGHT / 2) - (CHAR_HEIGHT / 2), '#', 0);
        }

        easy_menu.Display_Char(CHAR_WIDTH * 2 + show_page_index * CHAR_WIDTH, (SCREEN_HEIGHT / 2) - (CHAR_HEIGHT / 2), '>', 0);
    }
    else if (easy_menu.Display_Char_Line != NULL)
    {
        easy_menu.Display_Char_Line(0, EASY_MENU_LINE_MAX_NUM / 2, ch[ch_index], 0);

        for (unsigned char i = 0; i < show_page_index; i++)
        {
            easy_menu.Display_Char_Line(CHAR_WIDTH * 2 + i * CHAR_WIDTH, EASY_MENU_LINE_MAX_NUM / 2, '#', 0);
        }

        easy_menu.Display_Char_Line(CHAR_WIDTH * 2 + show_page_index * CHAR_WIDTH, EASY_MENU_LINE_MAX_NUM / 2, '>', 0);
    }

    if (++show_page_index >= show_page_len)
    {
        //        OLED_Clear();
        Easy_Menu_Goto_Page(PAGE(main_page));
    }

    if (++ch_index >= 4)
        ch_index = 0;
    /* USER CODE END */
}

/* =========================================================== 设置列表（普通页面） =========================================================== */
Item *main_page_items[11] = {
    ITEM(goto__start_page),
    ITEM(goto__Text_Page),
    ITEM(goto__Switch_Page),
    ITEM(goto__Data_Page),
    ITEM(goto__Enum_Page),
    ITEM(goto__User_Show_Page),
    ITEM(goto__Goto_Page),
    ITEM(goto__Data_Show),
    ITEM(goto__Gray),
    ITEM(goto__encoder),
    ITEM(goto__TASK)
};

Item *Text_Page_items[4] = {
    ITEM(text_page__1__item),
    ITEM(text_page__2__item),
    ITEM(text_page__3__item),
    ITEM(text_page__4__item)
};

Item *Switch_Page_items[4] = {
    ITEM(switch_page__1__item),
    ITEM(switch_page__2__item),
    ITEM(switch_page__3__item),
    ITEM(switch_page__4__item)
};

Item *Data_Page_items[7] = {
    ITEM(data_page__1__item),
    ITEM(data_page__2__item),
    ITEM(data_page__3__item),
    ITEM(data_page__4__item),
    ITEM(data_page__5__item),
    ITEM(data_page__6__item),
    ITEM(data_page__7__item)
};

Item *Enum_Page_items[2] = {
    ITEM(mode),
    ITEM(state)
};

Item *User_Show_Page_items[4] = {
    ITEM(user_show_page__1__item),
    ITEM(user_show_page__2__item),
    ITEM(user_show_page__3__item),
    ITEM(user_show_page__4__item)
};

Item *Goto_Page_items[4] = {
    ITEM(goto__goto_1_page),
    ITEM(goto__Goto_Page_2),
    ITEM(goto__goto_3_page),
    ITEM(goto__Goto_Page_4)
};

Item *goto_1_page_items[1] = {
    ITEM(goto__goto_11_page)
};

Item *goto_11_page_items[1] = {
    ITEM(goto__goto_111_page)
};

Item *goto_111_page_items[2] = {
    ITEM(goto_111_page__1__item),
    ITEM(goto__goto_111_page__2__item)
};

Item *goto_3_page_items[1] = {
    ITEM(test)
};

Item *Data_Show_items[3] = {
    ITEM(Data_Show__yaw),
    ITEM(Data_Show__roll),
    ITEM(Data_Show__pitch)
};

Item *Gray_items[12] = {
    ITEM(gray_digital),
    ITEM(CH1),
    ITEM(CH2),
    ITEM(CH3),
    ITEM(CH4),
    ITEM(CH5),
    ITEM(CH6),
    ITEM(CH7),
    ITEM(CH8),
    ITEM(gray_white_cal),
    ITEM(gray_black_cal),
    ITEM(gray__12__item)
};

Item *encoder_items[2] = {
    ITEM(show_speedA),
    ITEM(show_speedB)
};

Item *TASK_items[7] = {
    ITEM(timer),
    ITEM(task__1__item),
    ITEM(task__3__item),
    ITEM(task__4__item),
    ITEM(task__5__item),
    ITEM(task__6__item),
    ITEM(task__8__item)
};

/* ================================================================ 系统初始化 ================================================================ */
void Easy_Menu_Ui_Init(void)
{

    Ordinary_Page_Init(NULL, PAGE(main_page), "Main", main_page_items, 11);
        Goto_Item_Init(PAGE(main_page), ITEM(goto__start_page), "Start page", PAGE(start_page));
        Goto_Item_Init(PAGE(main_page), ITEM(goto__Text_Page), "Text Page", PAGE(Text_Page));
        Goto_Item_Init(PAGE(main_page), ITEM(goto__Switch_Page), "Switch_Page", PAGE(Switch_Page));
        Goto_Item_Init(PAGE(main_page), ITEM(goto__Data_Page), "Data_Page", PAGE(Data_Page));
        Goto_Item_Init(PAGE(main_page), ITEM(goto__Enum_Page), "Enum_Page", PAGE(Enum_Page));
        Goto_Item_Init(PAGE(main_page), ITEM(goto__User_Show_Page), "Show_Page", PAGE(User_Show_Page));
        Goto_Item_Init(PAGE(main_page), ITEM(goto__Goto_Page), "Goto_Page", PAGE(Goto_Page));
        Goto_Item_Init(PAGE(main_page), ITEM(goto__Data_Show), "Data_Show", PAGE(Data_Show));
        Goto_Item_Init(PAGE(main_page), ITEM(goto__Gray), "Gray", PAGE(Gray));
        Goto_Item_Init(PAGE(main_page), ITEM(goto__encoder), "encoder", PAGE(encoder));
        Goto_Item_Init(PAGE(main_page), ITEM(goto__TASK), "TASK", PAGE(TASK));

    Show_Page_Init(PAGE(main_page), PAGE(start_page), "Start page", 150, Start_Page_Enter_Callback, Start_Page_Period_Callback, NULL);

    Ordinary_Page_Init(PAGE(main_page), PAGE(Text_Page), "Text Page", Text_Page_items, 4);
        Text_Item_Init(PAGE(Text_Page), ITEM(text_page__1__item), "Welcome", NULL);
        Text_Item_Init(PAGE(Text_Page), ITEM(text_page__2__item), "Github:", Text_Page__2__Item_Callback);
        Text_Item_Init(PAGE(Text_Page), ITEM(text_page__3__item), "https://github.com/", NULL);
        Text_Item_Init(PAGE(Text_Page), ITEM(text_page__4__item), "2549850807/Easy_Menu", NULL);

    Ordinary_Page_Init(PAGE(main_page), PAGE(Switch_Page), "Switch_Page", Switch_Page_items, 4);
        Switch_Item_Init(PAGE(Switch_Page), ITEM(switch_page__1__item), "LED1", &Easy_Menu_Ui_Data.LED1__data, Switch_Page__1__Item_Callback);
        Switch_Item_Init(PAGE(Switch_Page), ITEM(switch_page__2__item), "LED2", &Easy_Menu_Ui_Data.LED2__data, Switch_Page__2__Item_Callback);
        Switch_Item_Init(PAGE(Switch_Page), ITEM(switch_page__3__item), "LED3", &Easy_Menu_Ui_Data.LED3__data, Switch_Page__3__Item_Callback);
        Switch_Item_Init(PAGE(Switch_Page), ITEM(switch_page__4__item), "LED4", &Easy_Menu_Ui_Data.LED4__data, Switch_Page__4__Item_Callback);

    Ordinary_Page_Init(PAGE(main_page), PAGE(Data_Page), "Data_Page", Data_Page_items, 7);
        Data_Item_Init(PAGE(Data_Page), ITEM(data_page__1__item), "uint8_t data", UNSIGNED_CHAR, &Easy_Menu_Ui_Data.uint8_data, UNSIGNED_CHAR_VAL(1), 1, UNSIGNED_CHAR_VAL(0), 0, UNSIGNED_CHAR_VAL(0), 0, Data_Page__1__Item_Callback);
        Data_Item_Init(PAGE(Data_Page), ITEM(data_page__2__item), "uint16_t data", UNSIGNED_SHORT_INT, &Easy_Menu_Ui_Data.uint16_data, UNSIGNED_SHORT_INT_VAL(1), 1, UNSIGNED_SHORT_INT_VAL(0), 0, UNSIGNED_SHORT_INT_VAL(0), 0, Data_Page__2__Item_Callback);
        Data_Item_Init(PAGE(Data_Page), ITEM(data_page__3__item), "uint32_t data", UNSIGNED_INT, &Easy_Menu_Ui_Data.uint32_data, UNSIGNED_INT_VAL(1), 1, UNSIGNED_INT_VAL(0), 0, UNSIGNED_INT_VAL(0), 0, Data_Page__3__Item_Callback);
        Data_Item_Init(PAGE(Data_Page), ITEM(data_page__4__item), "int8_t data", SIGNED_CHAR, &Easy_Menu_Ui_Data.int8_data, SIGNED_CHAR_VAL(1), 1, SIGNED_CHAR_VAL(0), 0, SIGNED_CHAR_VAL(0), 0, Data_Page__4__Item_Callback);
        Data_Item_Init(PAGE(Data_Page), ITEM(data_page__5__item), "int16_t data", SIGNED_SHORT_INT, &Easy_Menu_Ui_Data.int16_data, SIGNED_SHORT_INT_VAL(1), 1, SIGNED_SHORT_INT_VAL(0), 0, SIGNED_SHORT_INT_VAL(0), 0, Data_Page__5__Item_Callback);
        Data_Item_Init(PAGE(Data_Page), ITEM(data_page__6__item), "int32_t data", SIGNED_INT, &Easy_Menu_Ui_Data.int32_data, SIGNED_INT_VAL(1), 1, SIGNED_INT_VAL(0), 0, SIGNED_INT_VAL(0), 0, Data_Page__6__Item_Callback);
        Data_Item_Init(PAGE(Data_Page), ITEM(data_page__7__item), "float data", FLOAT, &Easy_Menu_Ui_Data.float_data, FLOAT_VAL(0.1), 1, FLOAT_VAL(-10), 1, FLOAT_VAL(10), 1, Data_Page__7__Item_Callback);

    Ordinary_Page_Init(PAGE(main_page), PAGE(Enum_Page), "Enum_Page", Enum_Page_items, 2);
        Enum_Item_Init(PAGE(Enum_Page), ITEM(mode), "Mode", mode_enum_str, 3, Mode_Callback);
        Enum_Item_Init(PAGE(Enum_Page), ITEM(state), "State", state_enum_str, 2, NULL);

    Ordinary_Page_Init(PAGE(main_page), PAGE(User_Show_Page), "Show_Page", User_Show_Page_items, 4);
        Show_Item_Init(PAGE(User_Show_Page), ITEM(user_show_page__1__item), "Hour", UNSIGNED_CHAR, &Easy_Menu_Ui_Data.hours, 10, User_Show_Page__1__Item_Callback);
        Show_Item_Init(PAGE(User_Show_Page), ITEM(user_show_page__2__item), "Minute", UNSIGNED_CHAR, &Easy_Menu_Ui_Data.minutes, 10, User_Show_Page__2__Item_Callback);
        Show_Item_Init(PAGE(User_Show_Page), ITEM(user_show_page__3__item), "Second", UNSIGNED_CHAR, &Easy_Menu_Ui_Data.seconds, 10, User_Show_Page__3__Item_Callback);
        Show_Item_Init(PAGE(User_Show_Page), ITEM(user_show_page__4__item), "Millisecond", UNSIGNED_CHAR, &Easy_Menu_Ui_Data.millisecond, 10, User_Show_Page__4__Item_Callback);

    Ordinary_Page_Init(PAGE(main_page), PAGE(Goto_Page), "Goto_Page", Goto_Page_items, 4);
        Goto_Item_Init(PAGE(Goto_Page), ITEM(goto__goto_1_page), "Goto 1 Page", PAGE(goto_1_page));
        Goto_Item_Init(PAGE(Goto_Page), ITEM(goto__Goto_Page_2), "Goto Page 2", NULL);
        Goto_Item_Init(PAGE(Goto_Page), ITEM(goto__goto_3_page), "Goto 3 Page", PAGE(goto_3_page));
        Goto_Item_Init(PAGE(Goto_Page), ITEM(goto__Goto_Page_4), "Goto Page 4", NULL);

    Ordinary_Page_Init(PAGE(Goto_Page), PAGE(goto_1_page), "Goto 1 Page", goto_1_page_items, 1);
        Goto_Item_Init(PAGE(goto_1_page), ITEM(goto__goto_11_page), "Goto 11 Page", PAGE(goto_11_page));

    Ordinary_Page_Init(PAGE(goto_1_page), PAGE(goto_11_page), "Goto 11 Page", goto_11_page_items, 1);
        Goto_Item_Init(PAGE(goto_11_page), ITEM(goto__goto_111_page), "Goto 111 Page", PAGE(goto_111_page));

    Ordinary_Page_Init(PAGE(goto_11_page), PAGE(goto_111_page), "Goto 111 Page", goto_111_page_items, 2);
        Text_Item_Init(PAGE(goto_111_page), ITEM(goto_111_page__1__item), "Hello World!!!", NULL);
        Goto_Item_Init(PAGE(goto_111_page), ITEM(goto__goto_111_page__2__item), "Home", PAGE(main_page));

    Ordinary_Page_Init(PAGE(Goto_Page), PAGE(goto_3_page), "Goto 3 Page", goto_3_page_items, 1);
        Text_Item_Init(PAGE(goto_3_page), ITEM(test), "TEST", NULL);

    Ordinary_Page_Init(PAGE(main_page), PAGE(Data_Show), "Data_Show", Data_Show_items, 3);
        Show_Item_Init(PAGE(Data_Show), ITEM(Data_Show__yaw), "yaw", FLOAT, &Easy_Menu_Ui_Data.yaw, 10, Data_Show__Yaw_Callback);
        Show_Item_Init(PAGE(Data_Show), ITEM(Data_Show__roll), "roll", FLOAT, &Easy_Menu_Ui_Data.roll, 10, Data_Show__Roll_Callback);
        Show_Item_Init(PAGE(Data_Show), ITEM(Data_Show__pitch), "pitch", FLOAT, &Easy_Menu_Ui_Data.pitch, 10, Data_Show__Pitch_Callback);

    Ordinary_Page_Init(PAGE(main_page), PAGE(Gray), "Gray", Gray_items, 12);
        Show_Item_Init(PAGE(Gray), ITEM(gray_digital), "gray_digital", UNSIGNED_CHAR, &Easy_Menu_Ui_Data.gray_digital_data, 10, Gray_Digital_Callback);
        Show_Item_Init(PAGE(Gray), ITEM(CH1), "CH1", UNSIGNED_SHORT_INT, &Easy_Menu_Ui_Data.CH1_data, 10, Ch1_Callback);
        Show_Item_Init(PAGE(Gray), ITEM(CH2), "CH2", UNSIGNED_SHORT_INT, &Easy_Menu_Ui_Data.CH2_data, 10, Ch2_Callback);
        Show_Item_Init(PAGE(Gray), ITEM(CH3), "CH3", UNSIGNED_SHORT_INT, &Easy_Menu_Ui_Data.CH3_data, 10, Ch3_Callback);
        Show_Item_Init(PAGE(Gray), ITEM(CH4), "CH4", UNSIGNED_SHORT_INT, &Easy_Menu_Ui_Data.CH4_data, 10, Ch4_Callback);
        Show_Item_Init(PAGE(Gray), ITEM(CH5), "CH5", UNSIGNED_SHORT_INT, &Easy_Menu_Ui_Data.CH5_data, 10, Ch5_Callback);
        Show_Item_Init(PAGE(Gray), ITEM(CH6), "CH6", UNSIGNED_SHORT_INT, &Easy_Menu_Ui_Data.CH6_data, 10, Ch6_Callback);
        Show_Item_Init(PAGE(Gray), ITEM(CH7), "CH7", UNSIGNED_SHORT_INT, &Easy_Menu_Ui_Data.CH7_data, 10, Ch7_Callback);
        Show_Item_Init(PAGE(Gray), ITEM(CH8), "CH8", UNSIGNED_SHORT_INT, &Easy_Menu_Ui_Data.CH8_data, 10, Ch8_Callback);
        Switch_Item_Init(PAGE(Gray), ITEM(gray_white_cal), "gray_white_cal", &Easy_Menu_Ui_Data.gray_white_cal, Gray_White_Cal_Callback);
        Switch_Item_Init(PAGE(Gray), ITEM(gray_black_cal), "gray_black_cal", &Easy_Menu_Ui_Data.gray_black_cal, Gray_Black_Cal_Callback);
        Show_Item_Init(PAGE(Gray), ITEM(gray__12__item), "gray__12__item", UNSIGNED_CHAR, &Easy_Menu_Ui_Data.gray__12__item__data, 100, Gray__12__Item_Callback);

    Ordinary_Page_Init(PAGE(main_page), PAGE(encoder), "encoder", encoder_items, 2);
        Show_Item_Init(PAGE(encoder), ITEM(show_speedA), "speedA", FLOAT, &Easy_Menu_Ui_Data.speedA, 10, Show_Speeda_Callback);
        Show_Item_Init(PAGE(encoder), ITEM(show_speedB), "speedB", FLOAT, &Easy_Menu_Ui_Data.speedB, 10, Show_Speedb_Callback);

    Ordinary_Page_Init(PAGE(main_page), PAGE(TASK), "TASK", TASK_items, 7);
        Show_Item_Init(PAGE(TASK), ITEM(timer), "time", UNSIGNED_CHAR, &Easy_Menu_Ui_Data.timer, 10, Timer_Callback);
        Switch_Item_Init(PAGE(TASK), ITEM(task__1__item), "task1", &Easy_Menu_Ui_Data.task1_flag, Task__1__Item_Callback);
        Switch_Item_Init(PAGE(TASK), ITEM(task__3__item), "task2", &Easy_Menu_Ui_Data.task2_flag, Task__3__Item_Callback);
        Switch_Item_Init(PAGE(TASK), ITEM(task__4__item), "task3", &Easy_Menu_Ui_Data.task3_flag, Task__4__Item_Callback);
        Switch_Item_Init(PAGE(TASK), ITEM(task__5__item), "task4", &Easy_Menu_Ui_Data.task4_flag, Task__5__Item_Callback);
        Switch_Item_Init(PAGE(TASK), ITEM(task__6__item), "task5", &Easy_Menu_Ui_Data.task5_flag, Task__6__Item_Callback);
        Data_Item_Init(PAGE(TASK), ITEM(task__8__item), "dist", UNSIGNED_INT, &Easy_Menu_Ui_Data.dist__data, UNSIGNED_INT_VAL(1), 1, UNSIGNED_INT_VAL(0), 0, UNSIGNED_INT_VAL(0), 0, Task__8__Item_Callback);
    
    Easy_Menu_Goto_Page(PAGE(main_page));
}
